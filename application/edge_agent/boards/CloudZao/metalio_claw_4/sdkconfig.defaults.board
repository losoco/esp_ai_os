## application/edge_agent/boards/CloudZao/metalio_claw_4/sdkconfig.defaults.board
```kconfig
#
# Flash / PSRAM
#
CONFIG_ESPTOOLPY_FLASHMODE_QIO=y
CONFIG_ESPTOOLPY_FLASHFREQ_80M=y
CONFIG_ESPTOOLPY_FLASHSIZE_32MB=y
CONFIG_SPIRAM=y
CONFIG_SPIRAM_MODE_HEX=y
CONFIG_SPIRAM_SPEED_200M=y
CONFIG_SPIRAM_FETCH_INSTRUCTIONS=y
CONFIG_SPIRAM_RODATA=y
CONFIG_SPIRAM_XIP_FROM_PSRAM=y
CONFIG_SPIRAM_FLASH_LOAD_TO_PSRAM=y
CONFIG_SPIRAM_USE_MALLOC=y
CONFIG_SPIRAM_MALLOC_ALWAYSINTERNAL=4096
CONFIG_SPIRAM_TRY_ALLOCATE_WIFI_LWIP=y
CONFIG_SPIRAM_MALLOC_RESERVE_INTERNAL=65536

#
# Chip revision
#
CONFIG_ESP32P4_SELECTS_REV_LESS_V3=y

#
# LVGL color depth (RGB888 to match NV3051F panel, no color loss)
#
CONFIG_LV_COLOR_DEPTH_24=y
# CONFIG_LV_COLOR_DEPTH_16 is not set
CONFIG_LV_COLOR_DEPTH=24

#
# Console (USB Serial JTAG)
#
CONFIG_ESP_CONSOLE_USB_SERIAL_JTAG=y
CONFIG_ESP_CONSOLE_SECONDARY_NONE=y
CONFIG_ESP_CONSOLE_USB_SERIAL_JTAG_ENABLED=y
CONFIG_ESP_CONSOLE_UART_NUM=-1

#
# BLE (disabled)
#
CONFIG_BT_ENABLED=n
CONFIG_APP_CLAW_LUA_MODULE_BLE_HID=n

#
# Wi-Fi Remote (ESP32-C5 coprocessor via ESP-Hosted SDIO)
#
CONFIG_ESP_WIFI_REMOTE_ENABLED=y
CONFIG_ESP_WIFI_REMOTE_IDF_SPECIFIC_ADDED=y
CONFIG_SLAVE_IDF_TARGET_ESP32C5=y
CONFIG_SLAVE_SOC_WIFI_SUPPORTED=y
CONFIG_SLAVE_SOC_WIFI_WAPI_SUPPORT=y
CONFIG_SLAVE_SOC_WIFI_CSI_SUPPORT=y
CONFIG_SLAVE_SOC_WIFI_MESH_SUPPORT=y
CONFIG_SLAVE_SOC_WIFI_NAN_SUPPORT=y
CONFIG_SLAVE_SOC_WIFI_LIGHT_SLEEP_CLK_WIDTH=12
CONFIG_SLAVE_SOC_WIFI_HW_TSF=y
CONFIG_SLAVE_FREERTOS_UNICORE=y
CONFIG_SLAVE_SOC_WIFI_GCMP_SUPPORT=y
CONFIG_SLAVE_SOC_WIFI_TXOP_SUPPORT=y
CONFIG_SLAVE_IDF_TARGET_ARCH_RISCV=y
CONFIG_SLAVE_SOC_WIFI_HE_SUPPORT=y
CONFIG_SLAVE_SOC_WIFI_MAC_VERSION_NUM=3
CONFIG_SLAVE_SOC_WIFI_SUPPORT_5G=y
CONFIG_SLAVE_IDF_ENV_BRINGUP=y

#
# ESP-Hosted config
#
CONFIG_ESP_HOSTED_CP_TARGET_ESP32C5=y
CONFIG_ESP_HOSTED_PRIV_ENABLE_WIFI_OPTIONS=y
CONFIG_ESP_HOSTED_IDF_SLAVE_TARGET="esp32c5"
CONFIG_ESP_HOSTED_P4_DEV_BOARD_NONE=y
CONFIG_ESP_HOSTED_PRIV_SDIO_OPTION=y
CONFIG_ESP_HOSTED_PRIV_SPI_HD_OPTION=y
CONFIG_ESP_HOSTED_SDIO_HOST_INTERFACE=y

#
# ESP-Hosted SDIO pin configuration (P4 host side)
# MetalioClaw4 uses non-default pins due to PCB layout:
#   CMD=50 CLK=51 D0=49 D1=34 D2=31 D3=53 RESET=54
#   (P4 defaults are CLK=18 CMD=19 D0-D3=14-17)
# Must set PRIV-level pin configs because ESP_HOSTED_SDIO_PIN_* derives from them.
#
CONFIG_ESP_HOSTED_SDIO_SLOT_1=y
CONFIG_ESP_HOSTED_SDIO_4_BIT_BUS=y
CONFIG_ESP_HOSTED_SDIO_CLOCK_FREQ_KHZ=40000
CONFIG_ESP_HOSTED_SDIO_RESET_ACTIVE_HIGH=y
CONFIG_ESP_HOSTED_PRIV_SDIO_PIN_CMD_SLOT_1=50
CONFIG_ESP_HOSTED_PRIV_SDIO_PIN_CLK_SLOT_1=51
CONFIG_ESP_HOSTED_PRIV_SDIO_PIN_D0_SLOT_1=49
CONFIG_ESP_HOSTED_PRIV_SDIO_PIN_D1_4BIT_BUS_SLOT_1=34
CONFIG_ESP_HOSTED_PRIV_SDIO_PIN_D2_4BIT_BUS_SLOT_1=31
CONFIG_ESP_HOSTED_PRIV_SDIO_PIN_D3_4BIT_BUS_SLOT_1=53
CONFIG_ESP_HOSTED_SDIO_GPIO_RESET_SLAVE=54
CONFIG_ESP_HOSTED_SDIO_RESET_DELAY_MS=1500
CONFIG_ESP_HOSTED_SDIO_OPTIMIZATION_RX_STREAMING_MODE=y
CONFIG_ESP_HOSTED_SLAVE_RESET_ON_EVERY_HOST_BOOTUP=y
CONFIG_ESP_HOSTED_ENABLE_PEER_DATA_TRANSFER=y

#
# SDIO LDO power control
# MetalioClaw4 shares LDO chan 4 between SDMMC slot 0 (SD card) and slot 1 (C5).
# When SD card is absent, the SD card driver releases the LDO, causing C5 to lose power.
# Enable this so ESP-Hosted configures its own LDO for SDIO slot 1 independently.
#
CONFIG_ESP_HOSTED_SD_PWR_CTRL_LDO_INTERNAL_IO=y

#
# Audio codec (dummy - no physical codec chip; raw I2S to BT module)
#
CONFIG_CODEC_DUMMY_SUPPORT=y
CONFIG_APP_CLAW_LUA_MODULE_AUDIO=y
CONFIG_APP_CLAW_LUA_MODULE_BT_AUDIO=y

#
# Camera (MIPI-CSI, OV2710)
#
CONFIG_CAMERA_OV2710=y
CONFIG_ESP_VIDEO_ENABLE_MIPI_CSI_VIDEO_DEVICE=y
CONFIG_ESP_VIDEO_ENABLE_ISP_PIPELINE_CONTROLLER=y
CONFIG_CAMERA_XCLK_USE_ESP_CLOCK_ROUTER=y

#
# Fuel Gauge (BQ27220, I2C 0x55)
#
CONFIG_APP_CLAW_LUA_MODULE_FUEL_GAUGE=y
CONFIG_APP_CLAW_LUA_MODULE_SC7A20H=y
CONFIG_APP_CLAW_LUA_MODULE_NU1680=y
CONFIG_APP_CLAW_LUA_MODULE_MAGNETOMETER=y
CONFIG_LUA_MODULE_MAGNETOMETER_CHIP_QMC6309=y
CONFIG_APP_CLAW_LUA_MODULE_GPS=y
CONFIG_APP_CLAW_LUA_MODULE_NT26=y

# USB MSC: expose SD card as USB mass storage for developer access
CONFIG_APP_USB_MSC_ENABLE=y
# CONFIG_APP_USB_MSC_READONLY is not set
CONFIG_TINYUSB_MSC_ENABLED=y
CONFIG_TINYUSB_RHPORT_HS=y
CONFIG_TINYUSB_MODE_DMA=y
```

## components/slave_ota/Kconfig
```kconfig
menu "ESP32-C5 Slave OTA"

config APP_SLAVE_OTA_MOCK
    bool "Mock ESP32-C5 slave OTA"
    default n
    help
      Exercise the ESP32-C5 slave OTA flow without calling esp_hosted_slave_ota_*.
      Disable before shipping.

config APP_SLAVE_OTA_MOCK_DURATION_MS
    int "Total mock duration (ms)"
    depends on APP_SLAVE_OTA_MOCK
    default 10000
    range 2000 60000

endmenu
```

## components/usb_msc/Kconfig.projbuild
```kconfig
menu "USB MSC"

config APP_USB_MSC_ENABLE
    bool "Expose mounted SD card as USB Mass Storage"
    default y if IDF_TARGET_ESP32P4 && ESP_BOARD_DEV_FS_FAT_SUPPORT
    help
        When enabled, the app exposes the board-manager mounted fs_sdcard
        device as a USB Mass Storage drive using TinyUSB.

config APP_USB_MSC_READONLY
    bool "Expose USB Mass Storage as read-only"
    default n
    depends on APP_USB_MSC_ENABLE
    help
        When enabled, the USB host can only read the exported SD card.
        When disabled, the USB host can read and write the exported SD card.

endmenu
```
